## config/west.yml
```yaml
manifest:
  remotes:
    - name: zmkfirmware
      url-base: https://github.com/zmkfirmware
    - name: badjeff
      url-base: https://github.com/badjeff
    - name: choovick
      url-base: https://github.com/choovick
  projects:
    - name: zmk
      remote: zmkfirmware
      revision: v0.3
      import: app/west.yml
    - name: zmk-pmw3610-driver
      remote: badjeff
      revision: main
    - name: zmk-config-charybdis
      remote: choovick
      revision: main
      path: modules/zmk-config-charybdis
  self:
    path: config
```
